/*
 * Copyright (C) 2012 Texas Instruments Incorporated - http://www.ti.com/
 *
 * This program is free software; you can redistribute it and/or modify
 * it under the terms of the GNU General Public License version 2 as
 * published by the Free Software Foundation.
 */

&uart1 {
	pinctrl-names = "default";

	rs485-rts-delay = <0 0>; 

	/* GPIO3 pin 21 for data direction */
	rts-gpio = <&gpio3 21 GPIO_ACTIVE_HIGH>;

	/* Enable RS-485 */
	linux,rs485-enabled-at-boot-time;

	status = "okay";
};
